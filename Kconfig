## Kconfig
```kconfig
menu "Easy_Input Config"

    menu "Push Buttons"
        config EASY_INPUT_PUSH_BUTTON_ENABLE
            bool "Enable Push Button Inputs"
            default y
            help
                This enables the use of normal pushbuttons as input

        config EASY_INPUT_PUSH_BUTTON_UP_PIN
            int 
            depends on EASY_INPUT_PUSH_BUTTON_ENABLE
            range -1 39
            prompt "Pin for UP Input"
            default -1
            help
                ESP32 GPIO Number

        config EASY_INPUT_PUSH_BUTTON_DOWN_PIN
            int 
            depends on EASY_INPUT_PUSH_BUTTON_ENABLE
            range -1 39
            prompt "Pin for DOWN Input"
            default -1
            help
                ESP32 GPIO Number

        config EASY_INPUT_PUSH_BUTTON_LEFT_PIN
            int 
            depends on EASY_INPUT_PUSH_BUTTON_ENABLE
            range -1 39
            prompt "Pin for LEFT Input"
            default -1
            help
                ESP32 GPIO Number

        config EASY_INPUT_PUSH_BUTTON_RIGHT_PIN
            int 
            depends on EASY_INPUT_PUSH_BUTTON_ENABLE
            range -1 39
            prompt "Pin for RIGHT Input"
            default -1
            help
                ESP32 GPIO Number

        config EASY_INPUT_PUSH_BUTTON_BACK_PIN
            int 
            depends on EASY_INPUT_PUSH_BUTTON_ENABLE
            range -1 39
            prompt "Pin for BACK Input"
            default -1
            help
                ESP32 GPIO Number

        config EASY_INPUT_PUSH_BUTTON_ENTER_PIN
            int 
            depends on EASY_INPUT_PUSH_BUTTON_ENABLE
            range -1 39
            prompt "Pin for ENTER Input"
            default -1
            help
                ESP32 GPIO Number

        config EASY_INPUT_PUSH_BUTTON_POLLING_PERIOD_MS
            int
            depends on EASY_INPUT_PUSH_BUTTON_ENABLE
            range 0 1000
            prompt "Milliseconds between push button polling periods"
            default 10
            help
                A higher number means less frequent polling, but uses less CPU cycles.
                Too high of a polling period and you might miss valid button presses.

        config EASY_INPUT_PUSH_BUTTON_DEBOUNCE_PERIOD
            int
            depends on EASY_INPUT_PUSH_BUTTON_ENABLE
            range 0 255
            prompt "Number of polling cycles with switch in active state to be considered actuated"
            default 4
            help
                A switch's counter is incremented everytime it is active during a polling
                cycle. A switch's counter is decremented everytime it is not active during
                a polling cycle. When a button's counter reaches this threshold, it is
                considered a successful button push.
    endmenu

    menu "Touch"
        config EASY_INPUT_TOUCH_ENABLE
            bool "Enable Touch Pad Inputs"
            default y
            help
                This enables the use of internal touch sensors as input

        config EASY_INPUT_TOUCH_UP_PIN
            int 
            depends on EASY_INPUT_TOUCH_ENABLE
            range -1 9
            prompt "Pin for UP Input"
            default -1
            help
                ESP32 GPIO Number

        config EASY_INPUT_TOUCH_DOWN_PIN
            int 
            depends on EASY_INPUT_TOUCH_ENABLE
            range -1 9
            prompt "Pin for DOWN Input"
            default -1
            help
                ESP32 GPIO Number

        config EASY_INPUT_TOUCH_LEFT_PIN
            int 
            depends on EASY_INPUT_TOUCH_ENABLE
            range -1 9
            prompt "Pin for LEFT Input"
            default -1
            help
                ESP32 GPIO Number

        config EASY_INPUT_TOUCH_RIGHT_PIN
            int 
            depends on EASY_INPUT_TOUCH_ENABLE
            range -1 9
            prompt "Pin for RIGHT Input"
            default -1
            help
                ESP32 GPIO Number

        config EASY_INPUT_TOUCH_BACK_PIN
            int 
            depends on EASY_INPUT_TOUCH_ENABLE
            range -1 9
            prompt "Pin for BACK Input"
            default -1
            help
                ESP32 GPIO Number

        config EASY_INPUT_TOUCH_ENTER_PIN
            int 
            depends on EASY_INPUT_TOUCH_ENABLE
            range -1 9
            prompt "Pin for ENTER Input"
            default -1
            help
                ESP32 GPIO Number

        config EASY_INPUT_TOUCH_FILTER_PERIOD_MS
            int
            depends on EASY_INPUT_TOUCH_ENABLE
            range 0 100
            prompt "Touch filter calibration."
            default 10
            help
                Touch filter calibration.

        config EASY_INPUT_TOUCH_THRESH_PERCENT
            int
            depends on EASY_INPUT_TOUCH_ENABLE
            range 0 1000
            prompt "Percentage of initial capacitance to trigger a touch."
            default 80
            help
                Percentage of initial capacitance to trigger a touch. Divide by 1000 to get percentage.
        config EASY_INPUT_TOUCH_PERIOD
           int
           depends on EASY_INPUT_TOUCH_ENABLE
           default 33
           prompt "Time in ms between polls"
           help
              help text here

        config EASY_INPUT_HOLD_ENABLE
            bool
            default y
            prompt "Enable Holding"
            help
               Enable hold for repeated touch

        config EASY_INPUT_HOLD_SLOW_DELAY
            int
            depends on EASY_INPUT_HOLD_ENABLE
            default 15
            prompt "Holding Slow Delay"
            help
               Number of periods from initial press until repeated touches at slow rate.

        config EASY_INPUT_HOLD_FAST_DELAY
            int
            depends on EASY_INPUT_HOLD_ENABLE
            default 30
            prompt "Holding Fast Delay"
            help
               Number of periods from initial press until repeated touches at fast rate.

        config EASY_INPUT_HOLD_SLOW_PERIOD
            int
            depends on EASY_INPUT_HOLD_ENABLE
            default 10
            prompt "Holding Slow Period"
            help
                period between slow repeat presses.

        config EASY_INPUT_HOLD_FAST_PERIOD
            int
            depends on EASY_INPUT_HOLD_ENABLE
            default 5
            prompt "Holding Fast Period"
            help
                period between fast repeat presses.

        endmenu

    config EASY_INPUT_QUEUE
        bool
        default y
        prompt "Place pressed buttons on a queue"
        help
            Place pressed buttons on a queue for external consumption.

    config EASY_INPUT_VOLATILE
        bool
        default y
        prompt "Toggle bits of a volatile variable when buttons are pressed."
        help
            Set bits in a volatile variable for when buttons are pressed for
            external consumption.

endmenu
```
